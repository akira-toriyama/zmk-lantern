## dts/bindings/behaviors/lantern,behavior-effect-next.yaml
```yaml
# Copyright (c) 2026 akira-toriyama
# SPDX-License-Identifier: MIT

description: |
  The effect-next behavior (CONFIG_LANTERN_EFFECT_NEXT, src/effect_next.c):
  one node, in the keymap's behaviors or an overlay, bound to a key of the
  central's keymap (a split's, or the keyboard's when it is not a split;
  `&effect_next`, no parameters). Each press picks the effect after the
  stored pick in src/effect.h's table, round again after the last, and keeps
  the pick's colour, through the effect behavior (the node effect), which
  carries it to every half of a split; with no pick stored, the effect
  after the default (a dongle: the table's first) in the conf's colour. It
  runs on the central only, where the keymap runs, so its name is free of
  the split transport's 8 characters. Unverified on hardware (the one
  consumer's keymap binds none).

compatible: "lantern,behavior-effect-next"

include: zero_param.yaml
```

## dts/bindings/behaviors/lantern,behavior-effect.yaml
```yaml
# Copyright (c) 2026 akira-toriyama
# SPDX-License-Identifier: MIT

description: |
  The effect behavior (CONFIG_LANTERN_EFFECT, src/effect.c): one node, named
  effect, on the split central and on every half, in the keymap's behaviors
  or an overlay (a name of at most 8 characters, as the palette's). The
  central's code invokes it with the host's pick, which of the effects built
  into a half's image draw and in which colour (param1 = a mask of
  src/effect.h's bits, param2 = 0xRRGGBB, or 0 for the palette's colours),
  and ZMK's split transport carries the same invocation to the halves by the
  node's name. A key of the central's keymap may bind it the same way
  (`&effect 1 0xFF0000`: the thin ring in red; `&effect 8 0`: the crossing
  ring in the palette's colours), for a keyboard without a host; the key
  binding is unverified on hardware (canon's keymap binds none).

compatible: "lantern,behavior-effect"

include: two_param.yaml
```

## dts/bindings/behaviors/lantern,behavior-hit.yaml
```yaml
# Copyright (c) 2026 akira-toriyama
# SPDX-License-Identifier: MIT

description: |
  The hit behavior (CONFIG_LANTERN_HIT, src/hit.c): one node, named hit, on
  the split central and on every half, in the keymap's behaviors or an
  overlay (a name of at most 8 characters, as the palette's). Never bound to
  a key: the central's code sends it to a half with one key press of another
  half (param1 = the key position, param2 = 0), and the half notes it as a
  hit for the effects that cross the split (the crossing ring, src/keys.c).

compatible: "lantern,behavior-hit"

include: two_param.yaml
```

## dts/bindings/behaviors/lantern,behavior-intro.yaml
```yaml
# Copyright (c) 2026 akira-toriyama
# SPDX-License-Identifier: MIT

description: |
  The intro behavior (CONFIG_LANTERN_INTRO, src/intro.c): one node, named
  intro, on the central (a split's, or the keyboard itself when it is not a
  split) and on every half, in the keymap's behaviors or
  an overlay (a name of at most 8 characters, as the palette's). The
  central's code invokes it with the host's pick of the intro, which of the
  intros built into a half's image the boot light plays (param1 = one bit of
  src/intro.h's, param2 = 0), and ZMK's split transport carries the same
  invocation to the halves by the node's name. A key of the central's keymap
  may bind it the same way (`&intro 2 0`: the star waves at the next boot
  light), for a keyboard without a host; the key binding is unverified on
  hardware (the one consumer's keymap binds none).

compatible: "lantern,behavior-intro"

include: two_param.yaml
```

## dts/bindings/behaviors/lantern,behavior-layer.yaml
```yaml
# Copyright (c) 2026 akira-toriyama
# SPDX-License-Identifier: MIT

description: |
  The layer behavior (CONFIG_LANTERN_LAYER, src/layer.c): one node, named
  layer, on the split central and on every half, in the keymap's behaviors
  or an overlay (a name of at most 8 characters, as the palette's). Never
  bound to a key: the central's code sends a half the state of the keymap's
  layer, which keys the layer that shows binds to something of its own and
  the palette slot of its colour (src/layer.h), and the half's layer keys
  draw it (CONFIG_LANTERN_LAYER_KEYS).

compatible: "lantern,behavior-layer"

include: two_param.yaml

properties:
  layers:
    type: array
    required: true
    description: |
      The layers that show, pairs of a layer of the keymap (its index, the
      order of the keymap's layer nodes) and the palette slot (0 to 5) its
      keys light in. The highest held layer named here shows; a held layer
      not named is passed over, and the default layer shows only when named.
      Read on the split central (a half needs the node, not the pairs).
```

## dts/bindings/behaviors/lantern,behavior-palette.yaml
```yaml
# Copyright (c) 2026 akira-toriyama
# SPDX-License-Identifier: MIT

description: |
  The palette behavior (CONFIG_LANTERN_PALETTE, src/palette.c): one node,
  named palette, on the split central and on every half, in the keymap's
  behaviors or an overlay. Never bound to a key: the central's code invokes
  it with one pair of slots (param1 = pair << 24 | the first slot's 0xRRGGBB,
  param2 = the second slot's), and ZMK's split transport carries the same
  invocation to the halves by the node's name.

compatible: "lantern,behavior-palette"

include: two_param.yaml
```

## dts/bindings/behaviors/lantern,behavior-tempo.yaml
```yaml
# Copyright (c) 2026 akira-toriyama
# SPDX-License-Identifier: MIT

description: |
  The tempo behavior (CONFIG_LANTERN_TEMPO_PICK, src/tempo.c): one node, named
  tempo, on the central (a split's, or the keyboard itself when it is not a
  split) and on every half, in the keymap's behaviors or
  an overlay (a name of at most 8 characters, as the palette's). The
  central's code invokes it with the host's pick of the tempo, whether the
  effects run faster the faster the user types (param1 = one bit of
  src/tempo.h's, on or off, param2 = 0), and ZMK's split transport carries
  the same invocation to the halves by the node's name. A key of the
  central's keymap may bind it the same way (`&tempo 1 0`: the tempo on;
  `&tempo 2 0`: off), for a keyboard without a host; the key binding is
  unverified on hardware (the one consumer's keymap binds none).

compatible: "lantern,behavior-tempo"

include: two_param.yaml
```

## dts/bindings/lantern,keys.yaml
```yaml
# Copyright (c) 2026 akira-toriyama
# SPDX-License-Identifier: MIT

description: |
  The key LEDs zmk-lantern paints (CONFIG_LANTERN_KEYS, src/keys.c): the LED
  strip under the keys and the key each LED sits under, and where the
  consumer says so the palette slot each key shows in the bands, the
  default picture, and where each key is. Exactly one per target with key
  LEDs (a split half); a target without one (a dongle) builds none of the
  painting. ZMK's underglow stays off on such a target: this module is the
  strip's one writer.

compatible: "lantern,keys"

include: base.yaml

properties:
  strip:
    type: phandle
    required: true
    description: |
      The LED strip device (a worldsemi,ws2812-spi node, or any Zephyr
      led_strip driver). Its chain-length is the LED count: the consumer sets
      it to the real number of LEDs (the WS2812 SPI driver sends and buffers
      the whole chain-length at every frame), and positions has one entry
      per LED.

  positions:
    type: array
    required: true
    description: |
      One entry per LED, in the chain's order: the key position the LED sits
      under, an index into the keymap (the longest physical layout's map
      where the keyboard has layouts, else the chosen matrix transform's;
      global across a split) and into slots. Measured on the hardware, one
      LED at a time (canon t-69g7).

  slots:
    type: array
    description: |
      One entry per key position, in position order (the whole keymap, both
      halves of a split): the palette slot, 0 to 5, the key's LED shows in
      the bands (CONFIG_LANTERN_BANDS, the default picture, and the bands
      intro, CONFIG_LANTERN_INTRO_BANDS, the boot light's default), and the
      colour of the crossing ring and the beams from that key. The length
      is the keymap's (ZMK_KEYMAP_LEN, asserted), so a table written in the
      keymap's shape reads as the bands. Without it every key is slot 0:
      the bands one colour, the palette's first.

  coords:
    type: array
    description: |
      Two entries per key position, in position order: the key's x and then
      its y in hundredths of a key unit, on the whole board (both halves of a
      split, so a distance reads the same from either), at most 30000 each.
      canon: imprint.json, keymap-drawer's physical layout, times 100 (each
      key's top left corner; every key is one unit, so the offset to the
      centre cancels). For what measures the board (CONFIG_LANTERN_GEOMETRY:
      an effect, the gradient and the star waves), which asserts it twice
      the keymap's length. Without it the keyboard's chosen
      zmk,physical-layout (else its first) places the keys, each at its
      centre in the layout's hundredths of a key unit (a rotated key as if
      unrotated), and positions must name that layout's keys; a keyboard
      with neither fails the build where something measures the board. A
      target that measures nothing needs none.

  scatter-weights:
    type: array
    description: |
      One entry per palette slot (six): the percentage of this half's LEDs
      the slot takes in the scatter (CONFIG_LANTERN_SCATTER), at most 100
      in all (asserted). Slots 1.. take their rounded share and slot 0, the
      heaviest colour, the rest, so slot 0's own entry only documents the
      intent. canon t-skdt: 50 20 10 5 5 0 (the 10 the shares leave go to
      slot 0 too). A target without the scatter needs none.
```

## dts/bindings/lantern,rail.yaml
```yaml
# Copyright (c) 2026 akira-toriyama
# SPDX-License-Identifier: MIT

description: |
  The LED power rail that zmk-lantern switches with its rule
  (CONFIG_LANTERN_RAIL under CONFIG_LANTERN_ON_USB_POWER): one GPIO that
  enables the supply of the key LEDs, the pin the board's
  zmk,ext-power-generic node has as control-gpios. That node stays disabled
  on a target with this one, and there is at most one of these per target.
  Optional: without it the rule paints black where it would cut the power,
  and the supply stays the board's (ZMK's ext_power driver, or always on).

compatible: "lantern,rail"

include: base.yaml

properties:
  gpios:
    type: phandle-array
    required: true
    description: The rail's enable pin; the rail is on while the pin is active.

  settle-ms:
    type: int
    default: 100
    description: |
      Milliseconds between enabling the rail and the first frame to the LEDs,
      their power-up time. The zmk,ext-power-generic node's init-delay-ms
      (100 on the Cyboard assimilator-bt board).
```
