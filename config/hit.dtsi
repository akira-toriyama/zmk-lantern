// The hit behavior's node (src/hit.c), the same on every device of the
// split, as the palette's (config/palette.dtsi says why one name): the
// central relays each half's key presses to the other half through it, for
// the effects that draw the other half's presses (src/effects/: the crossing
// ring, the beams, the thin ring, the disc, the water and the dart) and for
// the wake, which lights a half dark for idle at the other half's press
// (src/on_usb_power.c). A consumer with a keymap of its own puts it among
// the keymap's behaviors (canon: config/imprint_behaviors.dtsi); this check
// build includes this file from every overlay.

/ {
    behaviors {
        hit: hit {
            compatible = "lantern,behavior-hit";
            #binding-cells = <2>;
        };
    };
};
